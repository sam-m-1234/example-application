## app/src/modules/uplink/Kconfig
```kconfig
menuconfig UPLINK
    bool "Common helper code for Golioth MagTag Demo"
    help
      Build and link common code that is shared across MagTag samples.
if UPLINK
config UPLINK_SPI
    bool "Handle accelerometer readings"
    help
      Get accel from DeviceTree and write readings to shared sensor struct
config UPLINK_MQTT
    bool "Process button reads"
    help
      Configure buttons for interrupts with callbacks
config UPLINK_BT
    bool "ws2812 helper functions"
    help
      Intialize and update LED color and state
config UPLINK_MOCK
    bool "2.9\" grayscale ePaper driver"
    help
      Hardware driver for ePaper, including text and partial writes
endif # UPLINK
```

## west.yml
```yaml
# Copyright (c) 2021 Nordic Semiconductor ASA
# SPDX-License-Identifier: Apache-2.0

manifest:
  self:
    west-commands: scripts/west-commands.yml

  remotes:
    - name: zephyrproject-rtos
      url-base: https://github.com/zephyrproject-rtos

  projects:
    - name: ziota
      path: modules/lib/ziota
      revision: main
      url: https://github.com/sam-m-1234/ziota-zephyr-sdk.git
      import:
        west-external.yml
    - name: zephyr
      remote: zephyrproject-rtos
      revision: main
      import:
        # By using name-allowlist we can clone only the modules that are
        # strictly needed by the application.
        name-allowlist:
          - cmsis      # required by the ARM port
          - hal_nordic # required by the custom_plank board (Nordic based)
          - nanopb
          # - hal_stm32  # required by the nucleo_f302r8 board (STM32 based)
```
